## drivers/char/genode/Kconfig
```kconfig
config GENODE
tristate "Genode support for Linux"
select GENODE_HWIO
select GENODE_PLATFORM_INFO

config GENODE_HWIO
tristate "Genode hwio module"
depends on HAS_IOMEM

config GENODE_PLATFORM_INFO
tristate "platform_info ROM for Genode"
```
